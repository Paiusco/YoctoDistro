## meta-yocto-distro/conf/distro/embed-foss.conf
```bitbake
# Generic information
################################
DISTRO = "embed-foss"
DISTRO_NAME = "Embedded FOSS Lab"
DISTRO_VERSION = "0.0.1"
SDK_VENDOR = "-embedfosssdk"
MAINTAINER = "Andre Paiusco <andre.paiusco@proton.me>"

# Distro tweaking
################################
DISTRO_FEATURES = "\
    acl \
    ipv4 \
    systemd \
    usbgadget \
    usbhost \
    vfat \
    wifi \
    xattr \
    zeroconf \
"

PREFERRED_PROVIDER_virtual/kernel:qemuarm64 = "linux-yocto"
PREFERRED_PROVIDER_virtual/kernel = "linux-raspberrypi"

# Let's ensure all is dynamically linked
require conf/distro/include/no-static-libs.inc

# And add some security flags
require conf/distro/include/security_flags.inc

# Systemd is part of the distro features so let's remove sysvinit
DISTRO_FEATURES_BACKFILL_CONSIDERED = "sysvinit pulseaudio "
VIRTUAL-RUNTIME_init_manager = "systemd"
VIRTUAL-RUNTIME_initscripts = ""

# Infrastructure
################################
# Prevent stacking up old builds and do not symlink everything
IMAGE_NAME = "${IMAGE_BASENAME}-${MACHINE}"
IMAGE_LINK_NAME = ""
# Default the temp directory name in the build folder to tmp
TCLIBCAPPEND = ""
```

## meta-yocto-distro/conf/layer.conf
```bitbake
# We have a conf and classes directory, add to BBPATH
BBPATH .= ":${LAYERDIR}"

# We have recipes-* directories, add to BBFILES
BBFILES += "${LAYERDIR}/recipes-*/*/*.bb \
            ${LAYERDIR}/recipes-*/*/*.bbappend"

BBFILE_COLLECTIONS += "meta-yocto-distro"
BBFILE_PATTERN_meta-yocto-distro = "^${LAYERDIR}/"
BBFILE_PRIORITY_meta-yocto-distro = "6"

LAYERDEPENDS_meta-yocto-distro = "core"
# LAYERSERIES_COMPAT_meta-yocto-distro = "mickledore"
```
